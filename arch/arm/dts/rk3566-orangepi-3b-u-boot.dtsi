// SPDX-License-Identifier: (GPL-2.0+ OR MIT)

#include "rk356x-u-boot.dtsi"

#include <dt-bindings/gpio/gpio.h>
#include <dt-bindings/leds/common.h>

/ {
	chosen {
		stdout-path = &uart2;
		u-boot,spl-boot-order = &sdmmc0, &sdhci;
	};
};

&sdhci {
	cap-mmc-highspeed;
	mmc-hs200-1_8v;
};

&uart2 {
	bootph-all;
	clock-frequency = <24000000>;
	status = "okay";
};
